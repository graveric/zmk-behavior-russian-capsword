## Kconfig
```kconfig
DT_COMPAT_ZMK_BEHAVIOR_RUSSIAN_CAPSWORD := zmk,behavior-russian-capsword

config ZMK_BEHAVIOR_RUSSIAN_CAPSWORD
	bool
	default $(dt_compat_enabled,$(DT_COMPAT_ZMK_BEHAVIOR_RUSSIAN_CAPSWORD))
```

## dts/bindings/behaviors/zmk,behavior-russian-capsword.yaml
```yaml
# Copyright (c) 2026 The ZMK Contributors
# SPDX-License-Identifier: MIT

description: Russian caps word behavior

compatible: "zmk,behavior-russian-capsword"

include: zero_param.yaml

properties:
  continue-list:
    type: array
    required: true
  mods:
    type: int
```
