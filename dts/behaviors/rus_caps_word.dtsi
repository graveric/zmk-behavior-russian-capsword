#include <dt-bindings/zmk/behaviors.h>
#include <dt-bindings/zmk/keys.h>

/ {
	behaviors {
		/omit-if-no-ref/
		rus_caps_word: rus_caps_word {
			compatible = "zmk,behavior-russian-capsword";
			#binding-cells = <0>;
			continue-list = <UNDERSCORE BACKSPACE DELETE>;
			display-name = "Russian Caps Word";
		};
	};
};